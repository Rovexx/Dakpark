/*

*/
#include <Servo.h>

//new servo object
Servo konijnServo;

//servo output pin
int servoPin = 11;

//input pins
int buttonPin = 4;
int trainPin = 2;

//state of buttons 
int trainState = 0;
int shoot = 0;

int count = 0;
int hit = 0;

int up = 120;
bool bunnyUp = false;
bool wasUp = false;

int bunnyCounter = 0;
bool bunnyCount = false;

void setup() {
  Serial.begin(9600);
  pinMode(servoPin, OUTPUT);
  pinMode(buttonPin, INPUT);
  pinMode(trainPin, INPUT);
  konijnServo.attach(servoPin);
    
}

void loop() {
  shoot = digitalRead(buttonPin);
  trainState = digitalRead(trainPin);
  Serial.println(wasUp);
  
  trainClose();
  showBunny();
}

void trainClose(){
  if(trainState == 1 && wasUp == false){
    if(shoot == 1){
      bunnyMove(20);
      wasUp = true;
      bunnyCount = true;
    }else if(shoot == 0){
      bunnyMove(120);
      wasUp = false;
    }
  }else if(trainState == 0 && wasUp == false){
    bunnyMove(20);
  }
}

void bunnyMove(int degree){
  konijnServo.write(degree);
}

void showBunny(){
  if(bunnyCount == true){
    bunnyCounter ++;
    Serial.println(bunnyCounter);
  }
  
  if(bunnyCounter == 200){
    bunnyCount = false;
    wasUp = false;
    bunnyCounter = 0;
  }
}

